## drivers/serial/Kconfig.hostlink
```kconfig
# Virtual UART HOSTLINK driver option

# Copyright (c) 2023 Synopsys
# SPDX-License-Identifier: Apache-2.0

config UART_HOSTLINK
	bool "ARC HOSTLINK UART driver"
	default y
	depends on ARC
	depends on DT_HAS_SNPS_HOSTLINK_UART_ENABLED
	select SERIAL_HAS_DRIVER
	help
	  This option enables access HOSTLINK channel as UART device.
```

## dts/bindings/serial/snps,hostlink-uart.yaml
```yaml
# Copyright (c) 2020, CSIRO.
# SPDX-License-Identifier: Apache-2.0

description: ARC HOSTLINK UART

compatible: "snps,hostlink-uart"

include: uart-controller.yaml
```

## soc/arc/snps_nsim/Kconfig.defconfig.hs6x
```kconfig
# Copyright (c) 2019 Synopsys, Inc. All rights reserved.
# SPDX-License-Identifier: Apache-2.0

if SOC_NSIM_HS6X

config CPU_HS6X
	default y

config NUM_IRQ_PRIO_LEVELS
	# This processor supports 16 priority levels:
	# 0 for Fast Interrupts (FIRQs) and 1-15 for Regular Interrupts (IRQs).
	default 2

config NUM_IRQS
	# must be > the highest interrupt number used
	default 30

#TODO: drop this
config RGF_NUM_BANKS
	default 1

config SYS_CLOCK_HW_CYCLES_PER_SEC
	default 50000000

config HARVARD
	default y

#TODO: drop this
config ARC_FIRQ
	default n

config CACHE_MANAGEMENT
	default y

#TODO: move to ARC Kconfig
config TEST_EXTRA_STACKSIZE
	default 512

config CMSIS_THREAD_MAX_STACK_SIZE
	default 4096

config CMSIS_V2_THREAD_MAX_STACK_SIZE
	default 4096

config CMSIS_V2_THREAD_DYNAMIC_STACK_SIZE
	default 4096


endif # SOC_NSIM_HS6X
```

## soc/arc/snps_nsim/Kconfig.defconfig.hs_smp
```kconfig
# Copyright (c) 2019 Synopsys, Inc. All rights reserved.
# SPDX-License-Identifier: Apache-2.0

if SOC_NSIM_HS_SMP

config NUM_IRQ_PRIO_LEVELS
	# This processor supports 16 priority levels:
	# 0 for Fast Interrupts (FIRQs) and 1-15 for Regular Interrupts (IRQs).
	default 2

config NUM_IRQS
	# must be > the highest interrupt number used
	default 88

config RGF_NUM_BANKS
	default 1

config SYS_CLOCK_HW_CYCLES_PER_SEC
        # SMP simulation is slower than single core, 1 Mhz seems reasonable match with wallclock
	default 1000000

config HARVARD
	default y

config ARC_FIRQ
	default n

config CACHE_FLUSHING
	default y

config ARC_CONNECT
	default y

config 64BIT
	default y

config MP_NUM_CPUS
	default 2

config TEST_EXTRA_STACKSIZE
	default 512

config CMSIS_THREAD_MAX_STACK_SIZE
	default 4096

config CMSIS_V2_THREAD_MAX_STACK_SIZE
	default 4096

config CMSIS_V2_THREAD_DYNAMIC_STACK_SIZE
	default 4096

endif # SOC_NSIM_HS_SMP
```

## soc/arc/snps_qemu/Kconfig.defconfig.hs5x
```kconfig
# Copyright (c) 2021 Synopsys, Inc. All rights reserved.
# SPDX-License-Identifier: Apache-2.0

if SOC_QEMU_ARC_HS5X

config CPU_HS5X
	default y

config ARC_CONNECT
	default y

config MP_NUM_CPUS
	default 2
endif
```

## soc/arc/snps_qemu/Kconfig.defconfig.hs6x
```kconfig
# Copyright (c) 2021 Synopsys, Inc. All rights reserved.
# SPDX-License-Identifier: Apache-2.0

if SOC_QEMU_ARC_HS6X

config CPU_HS6X
	default y

config ARC_CONNECT
	default y

config MP_NUM_CPUS
	default 2
endif
```

## tests/arch/arc/interrupt/testcase.yaml
```yaml
common:
  arch_allow: arc
  tags: interrupt
  filter: not CONFIG_TRUSTED_EXECUTION_NONSECURE
tests:
  arc.interrupt.ctx-verify-from-coop:
    extra_configs:
      - CONFIG_FROM_COOP_THREAD=y
  arc.interrupt.ctx-verify-from-preempt:
    extra_configs:
      - CONFIG_FROM_COOP_THREAD=n
```

## tests/benchmarks/sys_kernel/testcase.yaml
```yaml
tests:
  benchmark.kernel.core:
    timeout: 120
    arch_exclude: nios2 riscv32 xtensa
    min_ram: 32
    tags: benchmark
```

## tests/crypto/tinycrypt/testcase.yaml
```yaml
tests:
  crypto.tinycrypt:
    tags: tinycrypt crypto aes ccm
    timeout: 550
    integration_platforms:
      - native_posix
```

## tests/kernel/mutex/sys_mutex/testcase.yaml
```yaml
tests:
  system.mutex:
    filter: CONFIG_ARCH_HAS_USERSPACE
    tags: kernel userspace
  system.mutex.nouser:
    tags: kernel
    timeout: 180
    extra_configs:
      - CONFIG_TEST_USERSPACE=n
```

## tests/kernel/semaphore/semaphore/testcase.yaml
```yaml
tests:
  kernel.semaphore:
    timeout: 420
    tags: kernel userspace ignore_faults
```

## tests/kernel/smp/testcase.yaml
```yaml
tests:
  kernel.multiprocessing.smp:
    timeout: 120
    tags:
      - kernel
      - smp
    ignore_faults: true
    filter: (CONFIG_MP_MAX_NUM_CPUS > 1)
  kernel.multiprocessing.smp.minimallibc:
    timeout: 120
    tags:
      - kernel
      - smp
      - libc
    ignore_faults: true
    filter: (CONFIG_MP_MAX_NUM_CPUS > 1) and CONFIG_MINIMAL_LIBC_SUPPORTED
    extra_configs:
      - CONFIG_MINIMAL_LIBC=y
```

## tests/kernel/threads/thread_init/testcase.yaml
```yaml
tests:
  kernel.threads.init:
    timeout: 450
    tags: kernel threads userspace
```

## tests/kernel/timer/timer_monotonic/testcase.yaml
```yaml
tests:
  kernel.timer.monotonic:
    timeout: 300
    tags: kernel timer
  kernel.timer.monotonic.linker_generator:
    platform_allow: qemu_cortex_m3
    tags: kernel timer linker_generator
    extra_configs:
      - CONFIG_CMAKE_LINKER_GENERATOR=y
```

## tests/subsys/cpp/libcxx/testcase.yaml
```yaml
common:
  integration_platforms:
    - mps2_an385
tests:
  cpp.libcxx:
    filter: TOOLCHAIN_HAS_NEWLIB == 1
    platform_exclude: qemu_x86_coverage
    toolchain_exclude: xcc
    min_flash: 54
    tags: cpp
    extra_configs:
        - CONFIG_NEWLIB_LIBC=y
  cpp.libcxx.exceptions:
    filter: TOOLCHAIN_HAS_NEWLIB == 1
    # FIXME: change when issue is resolved #32448
    platform_allow: mps2_an385
    toolchain_exclude: xcc
    min_flash: 54
    tags: cpp
    timeout: 5
    extra_configs:
        - CONFIG_EXCEPTIONS=y
        - CONFIG_NEWLIB_LIBC=y
  cpp.libcxx.extlib:
    platform_allow: nsim_hs nsim_em
    min_flash: 54
    tags: cpp
    extra_configs:
        - CONFIG_EXTERNAL_LIBC=y
```

## tests/subsys/jwt/testcase.yaml
```yaml
tests:
  libraries.encoding.jwt:
    min_ram: 96
    min_flash: 72
    timeout: 250
    tags: jwt
    integration_platforms:
      - native_posix
```
